## br2_external/package/x6100-gui/Config.in
```kconfig
config BR2_PACKAGE_X6100_GUI
	bool "x6100_gui"
	depends on BR2_PACKAGE_AETHER_X6100_CONTROL
	depends on BR2_PACKAGE_RHVOICE
	help
	  X6100 GUI application
```
